## conf/distro/embedded-container-distro.conf
```bitbake
include conf/distro/poky.conf

DISTRO = "embedded-container-distro"

# Append poky based features
DISTRO_FEATURES:append = " virtualization"

# Remove unused features
DISTRO_FEATURES_remove = " \
    3g \
    bluetooth \
    bluez5 \
    ipv6 \
    nfc \
    nfs \
    wifi \
    wayland \
    zeroconf \
    "

# Add these binaries to the HOSTTOOLS_NONFATAL variable to allow them to
# be called from within the recipe build task. They are specified as
# NONFATAL as they are not installed at the same time on the build
# system.
HOSTTOOLS_NONFATAL += "sudo pidof dockerd podman newgidmap newuidmap"
```
